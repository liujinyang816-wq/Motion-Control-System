/**
 ******************************************************************************
 * @file           : bsp_timer.c
 * @brief          : 板级定时器驱动 — 使用 TIM2 作为系统滴答
 * ----------------------------------------------------------------------------
 * 功能：
 *   1. bsp_GetTickCount() — 获取系统运行时间戳（TIM2 计数值）
 *   2. Delay_us() — 微秒级延时（软件循环，非精确）
 *   3. Delay_ms() — 毫秒级延时（基于 HAL_Delay）
 *
 * 定时器配置：
 *   - TIM2 作为自由运行计数器，用于超时检测
 *   - 时钟源: APB1 TIM Clock (200MHz)
 *   - 超时比较: bsp_GetTickCount() 返回 TIM2->CNT 当前值
 *
 * 注意：
 *   - Delay_us() 是软件空循环延时，精度受编译优化影响
 *   - Delay_ms() 使用 HAL_Delay() 基于 SysTick，精度较高
 ******************************************************************************
 */
#include "bsp_timer.h"
#include "osal.h"
#include "tim.h"

extern TIM_HandleTypeDef htim2;      /**< TIM2 句柄 (在 tim.c 中初始化) */

__IO uint32_t g_iRunTime = 0;       /**< 全局运行时间计数器 */

/* ============================================================================
 * bsp_GetTickCount() — 获取系统滴答计数值
 * ============================================================================
 * @retval TIM2->CNT 当前计数值
 *
 * 用于:
 *   - 超时检测（比较前后两次调用的差值）
 *   - 代码执行时间测量
 *   - DM9000 发送超时保护
 *
 * 示例用法:
 *   uint32_t start = bsp_GetTickCount();
 *   // ... 执行操作 ...
 *   if (bsp_GetTickCount() - start >= TIMEOUT_MS) { ... }
 */
uint32_t bsp_GetTickCount(void)
{
    g_iRunTime = __HAL_TIM_GET_COUNTER(&htim2);  // 读取TIM2当前计数值
    return g_iRunTime;
}

/* ============================================================================
 * Delay_us() — 微秒级软件延时
 * ============================================================================
 * @param time : 延时时间（微秒）
 *
 * 实现方式：软件空循环，在 400MHz CPU 频率下粗略校准
 * 内部循环 500 次 ≈ 1us（实际值取决于编译器优化和 CPU 频率）
 *
 * 注意：
 *   - 此函数不是精确延时！误差可能在 ±30% 以上
 *   - 不推荐用于需要精确时序的场景（如传感器时序）
 *   - 被中断打断时延时会变长
 */
void Delay_us(uint32_t time)
{
    uint32_t i = 0;
    while (time--)
    {
        i = 500;                       // 每次循环约1us (400MHz CPU)
        while (i--);                    // 软件空转
    }
}

/* ============================================================================
 * Delay_ms() — 毫秒级延时
 * ============================================================================
 * @param time : 延时时间（毫秒）
 *
 * 直接使用 HAL_Delay() 实现，基于 SysTick 中断
 * 精度依赖 SysTick 配置（默认 1ms 中断一次）
 */
void Delay_ms(uint32_t time)
{
    HAL_Delay(time);
}

/* ============================================================================
 * delay() — 简单软件空循环延时
 * ============================================================================
 * @param nCount : 循环计数（值越大延时越长）
 *
 * 最简延时：仅递减计数，无校准
 */
void delay(volatile uint32_t nCount)
{
    for (; nCount != 0; nCount--);
}
